## arch/arm/configs/jactive_att_defconfig
```kconfig
CONFIG_MACH_JACTIVE_ATT=y
CONFIG_MACH_JACTIVE=y
CONFIG_EXTRA_FIRMWARE="audience-es325-fw-jactive_att.bin audience-es325-fw-jactive_att_rev02.bin"
CONFIG_EXTRA_FIRMWARE_DIR="firmware"
CONFIG_AUTHENTEC_VPNCLIENT_INTERCEPTOR=m
CONFIG_FB_MSM_MIPI_RENESAS_TFT_VIDEO_FULL_HD_PT_PANEL=y
CONFIG_SUPPORT_SECOND_POWER=y
CONFIG_ESD_ERR_FG_RECOVERY=y
# TSP
CONFIG_TOUCHSCREEN_SYNAPTICS_PREVENT_HSYNC_LEAKAGE=y
#
CONFIG_SUPPORT_DISPLAY_OCTA_TFT=y
CONFIG_S5K3H5XA=y
CONFIG_S5K6B2YX=y
CONFIG_CAMERA_SW_I2C_ACT=y
CONFIG_IMX175_EEPROM=y
# CONFIG_FB_MSM_MIPI_SAMSUNG_OCTA_VIDEO_FULL_HD_PT_PANEL is not set
# CONFIG_LCD_VDD3_BY_PMGPIO is not set

# HALL IC is not supported
CONFIG_SENSORS_HALL=n
```

## arch/arm/configs/jactive_eur_defconfig
```kconfig
CONFIG_MACH_JACTIVE_EUR=y
CONFIG_EXTRA_FIRMWARE="audience-es325-fw-jactive-eur.bin"
CONFIG_EXTRA_FIRMWARE_DIR="firmware"

CONFIG_FB_MSM_MIPI_RENESAS_TFT_VIDEO_FULL_HD_PT_PANEL=y
CONFIG_SUPPORT_DISPLAY_OCTA_TFT=y
CONFIG_SUPPORT_SECOND_POWER=y
CONFIG_ESD_ERR_FG_RECOVERY=y
# CONFIG_FB_MSM_MIPI_SAMSUNG_OCTA_VIDEO_FULL_HD_PT_PANEL is not set
# CONFIG_LCD_VDD3_BY_PMGPIO is not set

#
# Wifi features
#
CONFIG_WCNSS_CORE=n
CONFIG_WIRELESS_EXT=n
CONFIG_PRIMA_WLAN=n

CONFIG_NET_CORE=y
CONFIG_WIRELESS=y
CONFIG_WIRELESS_EXT_SYSFS=y
CONFIG_WEXT_CORE=y
CONFIG_WEXT_PROC=y
CONFIG_CFG80211=y
CONFIG_CFG80211_DEFAULT_PS=y
CONFIG_CFG80211_WEXT=y
CONFIG_CFG80211_ALLOW_RECONNECT=y
CONFIG_WLAN=y
CONFIG_WIFI_CONTROL_FUNC=y
CONFIG_BCM4335=m
CONFIG_BROADCOM_WIFI_RESERVED_MEM=y
CONFIG_WLAN_REGION_CODE=100
CONFIG_MMC_MSM_SDC4_SUPPORT=y

CONFIG_S5K3H5XA=y
CONFIG_S5K6B2YX=y

CONFIG_BT_HCISMD=n
CONFIG_BT_HCIUART_IBS=n
CONFIG_BT_HCIUART=y
CONFIG_BT_BCM4335=y

CONFIG_SERIAL_MSM=y
CONFIG_SERIAL_MSM_HS=y

CONFIG_SEC_TORCH_FLASH=y

# HALL IC is not supported
CONFIG_SENSORS_HALL=n
```

## arch/arm/configs/jf_EUR_defconfig
```kconfig
CONFIG_MACH_JF_EUR=y
CONFIG_EXTRA_FIRMWARE="audience-es325-fw-eur.bin"
CONFIG_EXTRA_FIRMWARE_DIR="firmware"
```
