## arch/arm/configs/jf_vzw_defconfig
```kconfig
CONFIG_MACH_JF_VZW=y
CONFIG_EXTRA_FIRMWARE="audience-es325-fw-vzw.bin"
CONFIG_EXTRA_FIRMWARE_DIR="firmware"
CONFIG_AUTHENTEC_VPNCLIENT_INTERCEPTOR=m
#VMWARE RELATED
CONFIG_VMWARE_MVP=y
```

## drivers/block/eds/Kconfig
```kconfig
config EDS_MODULE
        tristate "EDS Module for TrueCrypt container"
	help
	  http://www.sovworks.com/details.html#compileModule
	  http://www.sovworks.com/eds/source/kernel-module/
```
